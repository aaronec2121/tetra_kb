## boards/shields/corne_tp/Kconfig.defconfig
```kconfig
# right half enables (also called central)
if SHIELD_CORNE_TP_RIGHT
    config ZMK_KEYBOARD_NAME
        default "tetra_kb"
    # Ensure this is set to 'y' for the right side or globally if right is master
    config ZMK_SPLIT_ROLE_CENTRAL
        default y
endif

#left half enables
if SHIELD_CORNE_TP_LEFT
    config ZMK_DISPLAY
        default y
endif

# global enables
if SHIELD_CORNE_TP_LEFT || SHIELD_CORNE_TP_RIGHT

    config ZMK_SPLIT
        default y
    
    if LVGL
        config LV_Z_VDB_SIZE
            default 64
        config LV_DPI_DEF
            default 148
        config LV_Z_BITS_PER_PIXEL
            default 1
        choice LV_COLOR_DEPTH
            default LV_COLOR_DEPTH_1
        endchoice
    endif # LVGL

endif
```
